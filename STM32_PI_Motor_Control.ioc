# file: STM32_PI_Motor_Control.ioc
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Mcu.Family=STM32F1
Mcu.Name=STM32F103C(8-B)Tx
Mcu.Package=LQFP48
NVIC.PriorityGroup=NVIC_PRIORITYGROUP_4
ProjectManager.HeapSize=0x200
ProjectManager.StackSize=0x400
ProjectManager.TargetToolchain=STM32CubeIDE
RCC.APB1Freq_Value=8000000
RCC.APB2Freq_Value=8000000
TIM2.AutoReloadPreload=TIM_AUTORELOAD_PRELOAD_ENABLE
TIM2.Period=9
TIM2.Prescaler=7199
VP_SYS_VS_ND.Mode=No_Debug
VP_TIM2_VS_ClockSourceINT.Mode=Internal
board=custom

// file: Core/Src/main.c
/* USER CODE BEGIN Header */
/**
  ******************************************************************************
  * @file           : main.c
  * @brief          : Main program body
  ******************************************************************************
  * @attention
  *
  * Copyright (c) 2025 STMicroelectronics.
  * All rights reserved.
  *
  * This software is licensed under terms that can be found in the LICENSE file
  * in the root directory of this software component.
  * If no LICENSE file comes with this software, it is provided AS-IS.
  *
  ******************************************************************************
  */
/* USER CODE END Header */
#include "main.h"

/* USER CODE BEGIN Includes */
#include "speed_data.h"
#include "current_data.h"
/* USER CODE END Includes */

/* USER CODE BEGIN PD */
#define KP  0.5f
#define KI  10.0f
#define TS  0.001f   // 1 ms

#define PWM_MAX 1000
#define PWM_MIN 0

#define RPM_REF 1500.0f

#define OVERCURRENT_LIMIT   5.0f     // Amps
#define STALL_SPEED_LIMIT  10.0f     // RPM
#define STALL_TIME_LIMIT   200       // ms
#define SPEED_MAX_LIMIT    3000.0f   // RPM
#define STALL_SPEED_THRESHOLD 100.0f
#define STALL_PWM_THRESHOLD   300.0f

/* USER CODE END PD */

TIM_HandleTypeDef htim2;

/* USER CODE BEGIN PV */
uint16_t sample_index = 0;
float speed_rpm = 0.0f;
float current_amp = 0.0f;
float integral_error = 0.0f;
uint8_t fault_overcurrent = 0;
uint8_t fault_stall = 0;
uint8_t fault_sensor = 0;

uint16_t stall_counter = 0;

/* USER CODE END PV */

void SystemClock_Config(void);
static void MX_TIM2_Init(void);
/* USER CODE BEGIN PFP */
void Control_ISR(void);
float PI_Controller(float reference, float feedback);
float Read_Speed_ADC(void);
float Read_Current_ADC(void);
void Set_PWM(float pwm);
/* USER CODE END PFP */

/* USER CODE BEGIN 0 */
void Control_ISR(void)
{
    float speed_feedback;
    float pwm;
    float current_feedback;

    speed_feedback = Read_Speed_ADC();
    current_feedback = Read_Current_ADC();
    if (current_feedback > OVERCURRENT_LIMIT)
    {
        fault_overcurrent = 1;
    }
    if (speed_feedback < STALL_SPEED_LIMIT)
    {
        stall_counter++;
        if (stall_counter >= STALL_TIME_LIMIT)
        {
            fault_stall = 1;
        }
    }

    else
    {
        stall_counter = 0;
    }

    if (speed_feedback < 0 || speed_feedback > SPEED_MAX_LIMIT)
        {
            fault_sensor = 1;
        }

    if (fault_overcurrent || fault_stall || fault_sensor)
    {
        Set_PWM(0);   // Stop motor
        return;       // Exit control loop
    }

    pwm = PI_Controller(RPM_REF, speed_feedback);

    if (fault_stall == 0)
    {
        Set_PWM(pwm);
    }
    else
    {
        Set_PWM(0);
    }

    /* ===== Stall Detection ===== */
    if ((pwm > STALL_PWM_THRESHOLD) &&
        (speed_feedback < STALL_SPEED_THRESHOLD))
    {
        stall_counter++;
        if (stall_counter >= STALL_TIME_LIMIT)
        {
            fault_stall = 1;
            Set_PWM(0);   // Stop motor
        }
    }
    else
    {
        stall_counter = 0;
    }

    sample_index++;
    if(sample_index >= DATA_LEN)
        sample_index = 0;
}

/* USER CODE END 0 */

/* USER CODE BEGIN 0 */

/* ===== Function Prototypes ===== */

/* ===== Control Parameters ===== */

/* ===== State Variables ===== */

/* USER CODE END 0 */

int main(void)
{

  /* MCU Configuration--------------------------------------------------------*/

  /* Reset of all peripherals, Initializes the Flash interface and the Systick. */
  HAL_Init();

  /* Configure the system clock */
  SystemClock_Config();

  /* Initialize all configured peripherals */
  MX_TIM2_Init();
  /* USER CODE BEGIN 2 */

  HAL_TIM_Base_Start_IT(&htim2);

  /* USER CODE END 2 */

  /* Infinite loop */
  while (1)
  {

  }
}

void SystemClock_Config(void)
{
  RCC_OscInitTypeDef RCC_OscInitStruct = {0};
  RCC_ClkInitTypeDef RCC_ClkInitStruct = {0};

  /** Initializes the RCC Oscillators according to the specified parameters
  * in the RCC_OscInitTypeDef structure.
  */
  RCC_OscInitStruct.OscillatorType = RCC_OSCILLATORTYPE_HSI;
  RCC_OscInitStruct.HSIState = RCC_HSI_ON;
  RCC_OscInitStruct.HSICalibrationValue = RCC_HSICALIBRATION_DEFAULT;
  RCC_OscInitStruct.PLL.PLLState = RCC_PLL_NONE;
  if (HAL_RCC_OscConfig(&RCC_OscInitStruct) != HAL_OK)
  {
    Error_Handler();
  }

  /** Initializes the CPU, AHB and APB buses clocks
  */
  RCC_ClkInitStruct.ClockType = RCC_CLOCKTYPE_HCLK|RCC_CLOCKTYPE_SYSCLK
                              |RCC_CLOCKTYPE_PCLK1|RCC_CLOCKTYPE_PCLK2;
  RCC_ClkInitStruct.SYSCLKSource = RCC_SYSCLKSOURCE_HSI;
  RCC_ClkInitStruct.AHBCLKDivider = RCC_SYSCLK_DIV1;
  RCC_ClkInitStruct.APB1CLKDivider = RCC_HCLK_DIV1;
  RCC_ClkInitStruct.APB2CLKDivider = RCC_HCLK_DIV1;

  if (HAL_RCC_ClockConfig(&RCC_ClkInitStruct, FLASH_LATENCY_0) != HAL_OK)
  {
    Error_Handler();
  }
}

static void MX_TIM2_Init(void)
{

  TIM_ClockConfigTypeDef sClockSourceConfig = {0};
  TIM_MasterConfigTypeDef sMasterConfig = {0};

  htim2.Instance = TIM2;
  htim2.Init.Prescaler = 7199;
  htim2.Init.CounterMode = TIM_COUNTERMODE_UP;
  htim2.Init.Period = 9;
  htim2.Init.ClockDivision = TIM_CLOCKDIVISION_DIV1;
  htim2.Init.AutoReloadPreload = TIM_AUTORELOAD_PRELOAD_ENABLE;
  if (HAL_TIM_Base_Init(&htim2) != HAL_OK)
  {
    Error_Handler();
  }
  sClockSourceConfig.ClockSource = TIM_CLOCKSOURCE_INTERNAL;
  if (HAL_TIM_ConfigClockSource(&htim2, &sClockSourceConfig) != HAL_OK)
  {
    Error_Handler();
  }
  sMasterConfig.MasterOutputTrigger = TIM_TRGO_RESET;
  sMasterConfig.MasterSlaveMode = TIM_MASTERSLAVEMODE_DISABLE;
  if (HAL_TIMEx_MasterConfigSynchronization(&htim2, &sMasterConfig) != HAL_OK)
  {
    Error_Handler();
  }

}

/* USER CODE BEGIN 4 */

float Read_Speed_ADC(void)
{
    return speed_table[sample_index];
}

float Read_Current_ADC(void)
{
    return current_table[sample_index];
}

float PI_Controller(float reference, float feedback)
{
    float error;
    float output;

    error = reference - feedback;
    integral_error += error * TS;

    output = (KP * error) + (KI * integral_error);

    if (output > PWM_MAX)
        output = PWM_MAX;
    else if (output < PWM_MIN)
        output = PWM_MIN;

    return output;
}

/* USER CODE END 4 */

void Error_Handler(void)
{
  __disable_irq();
  while (1)
  {
  }
}
